/**
 * @file gfx.c
 * @brief Embedded 2D graphics engine and 5x7 ASCII font renderer
 */
#include "gfx.h"
#include <string.h>
#include <stdlib.h>

/* Standard 5x7 font glyph table (ASCII 32 ' ' to 126 '~') */
static const uint8_t font5x7[95][5] = {
    {0x00, 0x00, 0x00, 0x00, 0x00}, /*   */
    {0x00, 0x00, 0x5F, 0x00, 0x00}, /* ! */
    {0x00, 0x07, 0x00, 0x07, 0x00}, /* " */
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    {0x08, 0x08, 0x2A, 0x1C, 0x08}  /* ~ */
};

void gfx_clear(uint16_t *fb, uint16_t color)
{
    for (int i = 0; i < LCD_W * LCD_H; i++) {
        fb[i] = color;
    }
}

void gfx_draw_pixel(uint16_t *fb, int x, int y, uint16_t color)
{
    if (x < 0 || x >= LCD_W || y < 0 || y >= LCD_H) return;
    fb[y * LCD_W + x] = color;
}

void gfx_fill_rect(uint16_t *fb, int x, int y, int w, int h, uint16_t color)
{
    if (x >= LCD_W || y >= LCD_H || w <= 0 || h <= 0) return;
    int x1 = (x < 0) ? 0 : x;
    int y1 = (y < 0) ? 0 : y;
    int x2 = (x + w > LCD_W) ? LCD_W : (x + w);
    int y2 = (y + h > LCD_H) ? LCD_H : (y + h);

    for (int j = y1; j < y2; j++) {
        int row = j * LCD_W;
        for (int i = x1; i < x2; i++) {
            fb[row + i] = color;
        }
    }
}

void gfx_draw_rect(uint16_t *fb, int x, int y, int w, int h, uint16_t color)
{
    if (w <= 0 || h <= 0) return;
    gfx_fill_rect(fb, x, y, w, 1, color);
    gfx_fill_rect(fb, x, y + h - 1, w, 1, color);
    gfx_fill_rect(fb, x, y, 1, h, color);
    gfx_fill_rect(fb, x + w - 1, y, 1, h, color);
}

void gfx_draw_line(uint16_t *fb, int x0, int y0, int x1, int y1, uint16_t color)
{
    int dx = abs(x1 - x0);
    int dy = abs(y1 - y0);
    int sx = (x0 < x1) ? 1 : -1;
    int sy = (y0 < y1) ? 1 : -1;
    int err = dx - dy;

    while (true) {
        gfx_draw_pixel(fb, x0, y0, color);
        if (x0 == x1 && y0 == y1) break;
        int e2 = 2 * err;
        if (e2 > -dy) {
            err -= dy;
            x0 += sx;
        }
        if (e2 < dx) {
            err += dx;
            y0 += sy;
        }
    }
}

void gfx_draw_char(uint16_t *fb, int x, int y, char c, uint16_t fg, uint16_t bg, int scale)
{
    if (c < 32 || c > 126) c = ' ';
    const uint8_t *glyph = font5x7[c - 32];

    for (int col = 0; col < 5; col++) {
        uint8_t line = glyph[col];
        for (int row = 0; row < 7; row++) {
            uint16_t color = (line & (1 << row)) ? fg : bg;
            if (color != 0x0001) { // 0x0001 can represent transparent if needed
                if (scale == 1) {
                    gfx_draw_pixel(fb, x + col, y + row, color);
                } else {
                    gfx_fill_rect(fb, x + col * scale, y + row * scale, scale, scale, color);
                }
            }
        }
    }
    // Trailing column for spacing
    if (bg != 0x0001) {
        if (scale == 1) {
            for (int row = 0; row < 7; row++) {
                gfx_draw_pixel(fb, x + 5, y + row, bg);
            }
        } else {
            gfx_fill_rect(fb, x + 5 * scale, y, scale, 7 * scale, bg);
        }
    }
}

void gfx_draw_str(uint16_t *fb, int x, int y, const char *str, uint16_t fg, uint16_t bg, int scale)
{
    if (!str) return;
    int cur_x = x;
    while (*str) {
        gfx_draw_char(fb, cur_x, y, *str, fg, bg, scale);
        cur_x += 6 * scale;
        str++;
    }
}
